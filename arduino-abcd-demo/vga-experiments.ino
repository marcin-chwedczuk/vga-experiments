// Font from: https://github.com/skiselev/8088_bios

const uint8_t font[] = {
  0x00, 0x00, 0x00, 0x00, 0x00, 0x00, 0x00, 0x00,
  0x7E, 0x81, 0xA5, 0x81, 0xBD, 0x99, 0x81, 0x7E,
  0x7E, 0xFF, 0xDB, 0xFF, 0xC3, 0xE7, 0xFF, 0x7E,
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  0x00, 0x10, 0x38, 0x6C, 0xC6, 0xC6, 0xFE, 0x00
};

#define PIN_VGA_MODE_SELECTOR 12
#define VGA_MODE_READ LOW
#define VGA_MODE_WRITE HIGH

#define PIN_MEM_WRITE 11

#define PIN_SHIFT_REG_LATCH 7
#define PIN_SHIFT_REG_DATA 8
#define PIN_SHIFT_REG_CLK 9

void setColumnAddr(uint8_t addr) {
  // Column address A0 - A4
  int apins[] = { A0, A1, A2, A3, A4 };
  for (int i = 0; i < sizeof(apins) / sizeof(apins[0]); i++) {
    digitalWrite(apins[i], (addr & 1) ? HIGH : LOW);
    addr >>= 1;
  }
}

void setRowAddrAndData(uint8_t rowAddr, uint8_t data) {
  digitalWrite(PIN_SHIFT_REG_LATCH, LOW);

  shiftOut(PIN_SHIFT_REG_DATA, PIN_SHIFT_REG_CLK, MSBFIRST, rowAddr);
  shiftOut(PIN_SHIFT_REG_DATA, PIN_SHIFT_REG_CLK, MSBFIRST, data);

  digitalWrite(PIN_SHIFT_REG_LATCH, HIGH);
}

void setup() {
  pinMode(PIN_MEM_WRITE, OUTPUT);  
  digitalWrite(PIN_MEM_WRITE, HIGH);

  pinMode(PIN_VGA_MODE_SELECTOR, OUTPUT);
  digitalWrite(PIN_VGA_MODE_SELECTOR, VGA_MODE_READ);

  pinMode(PIN_SHIFT_REG_LATCH, OUTPUT);
  pinMode(PIN_SHIFT_REG_DATA, OUTPUT);
  pinMode(PIN_SHIFT_REG_CLK, OUTPUT);

  // Column address A0 - A4
  int apins[] = { A0, A1, A2, A3, A4 };
  for (int i = 0; i < sizeof(apins) / sizeof(apins[0]); i++) {
    pinMode(apins[i], OUTPUT);
    digitalWrite(apins[i], LOW);
  }
}

void write(int row, int col, uint8_t data) {
  setColumnAddr(col);
  setRowAddrAndData((uint8_t)row, data);

  digitalWrite(PIN_VGA_MODE_SELECTOR, VGA_MODE_WRITE);
  delay(0);
  // Generate write pulse

  digitalWrite(PIN_MEM_WRITE, LOW);
  delay(0);
  digitalWrite(PIN_MEM_WRITE, HIGH);

  delay(0);
  digitalWrite(PIN_VGA_MODE_SELECTOR, VGA_MODE_READ);
}

void printCharAt(int row, int col, char c) {
  for (int i = 0; i < 8; i++) {
    uint8_t data = font[c*8 + i];
    write(row + i, col, data);
  }
}

void printStringAt(int row, int col, const char* str) {
  while(*str) {
    printCharAt(row, col, *str);
    str++;
    col++;
  }
}

void clearScreen(uint8_t data) {
  for (int col = 0; col < 25; col++) {
    for (int r = 0; r < 150; r++) {
      write(r, col, data);
    }
  }
}

void clearScreenChar(char data) {
  for (int col = 0; col < 25; col++) {
    for (int r = 0; r < 150; r+=8) {
      printCharAt(r, col, data);
    }
  }
}

int c = 'A';
void loop() {
  clearScreenChar(c++);
  delay(1000);
  if (c > 'Z') { c = 'A'; }
}
